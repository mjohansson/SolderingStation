/** @file
 * Quick'n'dirty driver for SSD1322-based OLED display (256x64 4bpp)
 *
 *
 * @author Mathias Johansson (e96mjh@gmail.com)
 *
 * © Copyright Mathias Johansson 2019
 *
 */


////////////////////////////////////////////////////////////////////////////////
/**
 * @name Includes
 */
//@{

#include "ssd1322.h"
#include "stm32f1xx_hal.h"
#include "main.h"  // named defines of GPIO ports & pins
#include "spi.h"
#include "usart.h"

//@} End of Includes



////////////////////////////////////////////////////////////////////////////////
/**
 * @name Local defines
 */
//@{

#define set_column_address(a,b)    ssd1322_cmd2(SET_COLUMN_ADDRESS, a, b)
#define set_row_address(a, b)      ssd1322_cmd2(SET_ROW_ADDRESS, a, b)
#define set_write_ram()            ssd1322_cmd(WRITE_RAM_COMMAND)
#define set_remap_format(a)        ssd1322_cmd2(SET_REMAP_DUAL_MODE, a, 0x11)
#define set_start_line(a)          ssd1322_cmd1(SET_DISPLAY_START_LINE, a)
#define set_display_offset(a)      ssd1322_cmd1(SET_DISPLAY_OFFSET, a)
#define set_display_mode(a)        ssd1322_cmd0(SET_DISPLAY_MODE_OFF | ((a)&0x03))
#define set_partial_display(a, b)  ssd1322_cmd2(ENABLE_PARTIAL_DISPLAY, a, b)
#define exit_partial_display()     ssd1322_cmd0(EXIT_PARTIAL_DISPLAY)
#define set_function_selection(a)  ssd1322_cmd1(FUNCTION_SELECTION, a)
#define set_display_off()          ssd1322_cmd0(SET_SLEEP_MODE_ON)
#define set_display_on()           ssd1322_cmd0(SET_SLEEP_MODE_OFF)
#define set_phase_length(a)        ssd1322_cmd1(SET_PHASE_LENGTH, a)
#define set_display_clock(a)       ssd1322_cmd1(SET_CLOCK_DIV_OSC_FREQ, a)
#define set_display_enh_a(a, b)    ssd1322_cmd2(DISPLAY_ENHANCEMENT_A, 0xa0|(a), 0x05|(b))
#define set_gpio(a)                ssd1322_cmd1(SET_GPIO, a)
#define set_precharge_period(a)    ssd1322_cmd1(SET_2ND_PRECHARGE_PER, a)
#define set_precharge_voltage(a)   ssd1322_cmd1(SET_PRECHARGE_VOLTAGE, a)
#define set_vcomh(a)               ssd1322_cmd1(SET_VCOMH, a)
#define set_contrast(a)            ssd1322_cmd1(SET_CONTRAST_CURRENT, a)
#define set_master_contrast(a)     ssd1322_cmd1(MASTER_CONTRAST_CTRL, a)
#define set_mux_ratio(a)           ssd1322_cmd1(SET_MUX_RATIO, a)
#define set_display_enh_b(a)       ssd1322_cmd2(DISPLAY_ENHANCEMENT_B, 0x82|(a), 0x20)
#define set_command_lock()         ssd1322_cmd1(SET_COMMAND_LOCK, 0x16)
#define set_command_unlock()       ssd1322_cmd1(SET_COMMAND_LOCK, 0x12)
#define set_linear_grayscale()     ssd1322_cmd0(SET_LINEAR_GRAYSCALE)


//@} End of Local defines



////////////////////////////////////////////////////////////////////////////////
/**
 * @name Typedefs
 * Local typedefs related to this functionality.
 */
//@{


//@} End of Typedefs



////////////////////////////////////////////////////////////////////////////////
/**
 * @name Local data
 */
//@{

/** Default linear greyscale PWM values (cmd 0xb9) */
static const uint8_t ssd1322_default_gs_values[16] = {
    0x00, 0x00, 0x08, 0x10, 0x18, 0x20, 0x28, 0x30,
    0x38, 0x40, 0x48, 0x50, 0x58, 0x60, 0x68, 0x70
};


// Auto-created with glcd_convert.py from file ../../images/weller/Logo_256x64.png
// Bitmap from "../../images/weller/Logo_256x64.png" (256x64 pixels) :
const uint8_t Logo_256x64[8192] = {
    0x00, 0x00, 0x00, 0x00, 0x00, 0x00, 0x00, 0x00,
    0x00, 0x00, 0x00, 0x00, 0x00, 0x00, 0x00, 0x00,
    0x00, 0x00, 0x00, 0x00, 0x01, 0x22, 0x32, 0x00,
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    0x00, 0x00, 0x00, 0x00, 0x00, 0x00, 0x00, 0x00,
    };

//@} End of Local data



////////////////////////////////////////////////////////////////////////////////
/**
 * @name Global data
 */
//@{


//@} End of Global data



////////////////////////////////////////////////////////////////////////////////
/**
 * @name Private methods
 */
//@{

static void ssd1322_cmd(uint8_t cmd);

static void ssd1322_cmd0(uint8_t cmd);

static void ssd1322_cmd1(uint8_t cmd, uint8_t a);

static void ssd1322_cmd2(uint8_t cmd, uint8_t a, uint8_t b);

static void ssd1322_data(uint8_t data);

static void ssd1322_data2(uint8_t data1, uint8_t data2);

static void ssd1322_data4(uint32_t data4);

static void ssd1322_dataN(const uint8_t *data, uint32_t length);

static void set_grayscale_table(uint8_t *data, uint32_t length);


//@} End of Private methods



////////////////////////////////////////////////////////////////////////////////
/**
 * @name Interrupt handlers
 */
//@{


//@} End of Interrupt handlers



////////////////////////////////////////////////////////////////////////////////
/**
 * @name Implemented public methods
 */
//@{

void ssd1322_init(void)
{
    // Set BS[1:0] to select bus interface cfg
    // 00 = 4-line SPI (D0 = SCLK; D1 = MOSI; D2 = N/C; Dx = gnd)
    // 01 = 3-line SPI
    // 10 = 8b 8080 parallel
    // 11 = 8b 6800 parallel
// NOTE: BS is hardwired to 00 on SolderStation Frontpanel-inner!
//    HAL_GPIO_WritePin(DISP_BS1_GPIO_Port, DISP_BS1_Pin, GPIO_PIN_RESET);
//    HAL_GPIO_WritePin(DISP_BS0_GPIO_Port, DISP_BS0_Pin, GPIO_PIN_RESET);

    // Release display CSn and DCn
    HAL_GPIO_WritePin(DISP_DCn_GPIO_Port, DISP_DCn_Pin, GPIO_PIN_SET);
    HAL_GPIO_WritePin(DISP_CSn_GPIO_Port, DISP_CSn_Pin, GPIO_PIN_SET);
    // assert reset
    HAL_GPIO_WritePin(SYS_RSTn_GPIO_Port, SYS_RSTn_Pin, GPIO_PIN_RESET);
    HAL_Delay(1);
    // release reset
    HAL_GPIO_WritePin(SYS_RSTn_GPIO_Port, SYS_RSTn_Pin, GPIO_PIN_SET);
    HAL_Delay(1);

    // init seq.
    HAL_GPIO_WritePin(DISP_CSn_GPIO_Port, DISP_CSn_Pin, GPIO_PIN_RESET);
    __NOP();
    __NOP();

    set_command_unlock();
    set_display_off();
    set_column_address(0x1c, 0x5b);  // col0 = seg112 = addr 0x1c -> col255 = seg367 = addr 0x5b
    set_row_address(0x00, 0x3f);
    set_display_clock(0x91);   // 80 FPS
    set_mux_ratio(0x3f);       // 1/64
    set_display_offset(0x00);
    set_start_line(0x00);
    set_remap_format(0x14);    // H+, C0 = SEG0, Enable nibble remap, scan COM63..COM0,
                               //  (Implicit B = 0x11 ; No COM split, dual COM line mode)
    set_gpio(0x00);
    set_function_selection(0x01);
    set_display_enh_a(0xa0, 0xfd);     // Enable external VSL
    set_contrast(112);
    set_master_contrast(0x0f);
    set_linear_grayscale();
    set_phase_length(0xe2);            // Phase 1=5 clks, phase 2=14 clks
    set_display_enh_b(0x20);           // Enhance driving scheme capability
    set_precharge_voltage(0x1f);       // 0.60*VCC
    set_precharge_period(0x08);        // 2nd precharge period = 8 clks
    set_vcomh(0x07);                   // COM deselect voltage = 0.86*VCC
    set_display_mode(DISPLAY_NORMAL);  // Display mode = Normal
    exit_partial_display();
    HAL_GPIO_WritePin(DISP_CSn_GPIO_Port, DISP_CSn_Pin, GPIO_PIN_SET);
    HAL_Delay(100);

    HAL_GPIO_WritePin(DISP_CSn_GPIO_Port, DISP_CSn_Pin, GPIO_PIN_RESET);
    set_display_on();
    HAL_GPIO_WritePin(DISP_CSn_GPIO_Port, DISP_CSn_Pin, GPIO_PIN_SET);

}


void ssd1322_uninit(void)
{
    HAL_GPIO_WritePin(DISP_CSn_GPIO_Port, DISP_CSn_Pin, GPIO_PIN_RESET);
    set_display_off();
    HAL_GPIO_WritePin(DISP_CSn_GPIO_Port, DISP_CSn_Pin, GPIO_PIN_SET);
    HAL_Delay(10);

    // TODO: disable HV boost..?
    // HAL_Delay(100);

    // Release display CSn and DCn
    HAL_GPIO_WritePin(DISP_DCn_GPIO_Port, DISP_DCn_Pin, GPIO_PIN_SET);
    HAL_GPIO_WritePin(DISP_CSn_GPIO_Port, DISP_CSn_Pin, GPIO_PIN_SET);
    // Assert reset; then set all signals "off"
    HAL_Delay(1);
    HAL_GPIO_WritePin(SYS_RSTn_GPIO_Port, SYS_RSTn_Pin, GPIO_PIN_RESET);
    HAL_Delay(1);
    HAL_GPIO_WritePin(DISP_DCn_GPIO_Port, DISP_DCn_Pin, GPIO_PIN_RESET);
    HAL_GPIO_WritePin(DISP_CSn_GPIO_Port, DISP_CSn_Pin, GPIO_PIN_RESET);
}

void ssd1322_set_display_mode(ssd1322_display_mode_t mode)
{
    HAL_GPIO_WritePin(DISP_CSn_GPIO_Port, DISP_CSn_Pin, GPIO_PIN_RESET);
    set_display_mode(mode);
    HAL_GPIO_WritePin(DISP_CSn_GPIO_Port, DISP_CSn_Pin, GPIO_PIN_SET);
}

uint8_t ssd1322_set_dimming(uint8_t data)
{
    if (data > 0x0f) data = 0x0f;
    set_master_contrast(data);
    return data;
}

uint8_t ssd1322_set_brightness(uint8_t data)
{
    set_contrast(data);
    return data;
}

void ssd1322_update_display(const uint8_t* data, uint32_t length)
{
    HAL_GPIO_WritePin(DISP_CSn_GPIO_Port, DISP_CSn_Pin, GPIO_PIN_RESET);
	set_column_address(0x1c,0x5b);
	set_row_address(0x00,0x3F);
    set_write_ram();
    ssd1322_dataN(data, length);
    HAL_GPIO_WritePin(DISP_CSn_GPIO_Port, DISP_CSn_Pin, GPIO_PIN_SET);
}

void ssd1322_fill_display(uint32_t pattern)
{
	set_column_address(0x1c, 0x5b);
	set_row_address(0x00,0x3F);
    set_write_ram();
    for (int y = 0; y < 64; y++) {
        for (int x = 0; x < 256/8; x++) {
            ssd1322_data4(pattern);
            /* uint8_t d; */
            /* d = (pattern >> 24) & 0xff; */
            /* ssd1322_data(d); */
            /* d = (pattern >> 16) & 0xff; */
            /* ssd1322_data(d); */
            /* d = (pattern >> 8) & 0xff; */
            /* ssd1322_data(d); */
            /* d = pattern & 0xff; */
            /* ssd1322_data(d); */
        }
    }
    HAL_GPIO_WritePin(DISP_CSn_GPIO_Port, DISP_CSn_Pin, GPIO_PIN_SET);
}

//@} End of Implemented public methods



////////////////////////////////////////////////////////////////////////////////
/**
 * @name Implemented callback functions
 * These methods are exported to other modules, but are callback handlers, not
 * intended to be invoked under any other circumstanses than the CB notification.
 */
//@{


//@} End of Implemented callback functions



////////////////////////////////////////////////////////////////////////////////
/**
 * @name Implemented private methods
 */
//@{

static uint8_t g_data_buf[4] __attribute__((aligned(4))) = { 0xde, 0xad, 0xbe, 0xef };

static void ssd1322_cmd(uint8_t cmd)
{
    HAL_StatusTypeDef res;
    // Assert CSn and DCn
    HAL_GPIO_WritePin(DISP_DCn_GPIO_Port, DISP_DCn_Pin, GPIO_PIN_RESET);
    HAL_GPIO_WritePin(DISP_CSn_GPIO_Port, DISP_CSn_Pin, GPIO_PIN_RESET);

    g_data_buf[0] = cmd;
    res = HAL_SPI_Transmit(&hspi1, &g_data_buf[0], sizeof(uint8_t), 1);
    assert_param(res == HAL_OK);
    if (res != HAL_OK) {
        uart_printf("  cmd=0x%02X, res = %u\n", cmd, res);
    }

    // Release DCn; DO NOT RELEASE CSn; assume it's handled out of scope
    //HAL_GPIO_WritePin(DISP_CSn_GPIO_Port, DISP_CSn_Pin, GPIO_PIN_SET);
    HAL_GPIO_WritePin(DISP_DCn_GPIO_Port, DISP_DCn_Pin, GPIO_PIN_SET);
}

static void ssd1322_data(uint8_t data)
{
    // ASSUME : CSn is pre-asserted out of scope!
    HAL_StatusTypeDef res;
    // Set DCn and enable CSn
    HAL_GPIO_WritePin(DISP_DCn_GPIO_Port, DISP_DCn_Pin, GPIO_PIN_SET);
    //HAL_GPIO_WritePin(DISP_CSn_GPIO_Port, DISP_CSn_Pin, GPIO_PIN_RESET);

    g_data_buf[0] = data;
    res = HAL_SPI_Transmit(&hspi1, &g_data_buf[0], sizeof(uint8_t), 1);
    assert_param(res == HAL_OK);
    if (res != HAL_OK) {
        uart_printf("  data=0x%02X, res = %u\n", data, res);
    }

    // Release DCn; DO NOT RELEASE CSn; assume it's handled out of scope
    //HAL_GPIO_WritePin(DISP_CSn_GPIO_Port, DISP_CSn_Pin, GPIO_PIN_SET);
    HAL_GPIO_WritePin(DISP_DCn_GPIO_Port, DISP_DCn_Pin, GPIO_PIN_SET);
}

static void ssd1322_data2(uint8_t data1, uint8_t data2)
{
    // ASSUME : CSn is pre-asserted out of scope!
    HAL_StatusTypeDef res;
    // Set DCn and enable CSn
    HAL_GPIO_WritePin(DISP_DCn_GPIO_Port, DISP_DCn_Pin, GPIO_PIN_SET);
    //HAL_GPIO_WritePin(DISP_CSn_GPIO_Port, DISP_CSn_Pin, GPIO_PIN_RESET);

    g_data_buf[0] = data1; g_data_buf[1] = data2;
    res = HAL_SPI_Transmit(&hspi1, &g_data_buf[0], 2*sizeof(uint8_t), 2);
    assert_param(res == HAL_OK);
    if (res != HAL_OK) {
        uart_printf("  data2=0x%02X %02X, res = %u\n", data1, data2, res);
    }

    // Release DCn; DO NOT RELEASE CSn; assume it's handled out of scope
    //HAL_GPIO_WritePin(DISP_CSn_GPIO_Port, DISP_CSn_Pin, GPIO_PIN_SET);
    HAL_GPIO_WritePin(DISP_DCn_GPIO_Port, DISP_DCn_Pin, GPIO_PIN_SET);
}

static void ssd1322_data4(uint32_t data4)
{
    // ASSUME : CSn is pre-asserted out of scope!
    HAL_StatusTypeDef res;
    uint32_t *gp = (uint32_t*)&g_data_buf;
    // Set DCn and enable CSn
    HAL_GPIO_WritePin(DISP_DCn_GPIO_Port, DISP_DCn_Pin, GPIO_PIN_SET);
    //HAL_GPIO_WritePin(DISP_CSn_GPIO_Port, DISP_CSn_Pin, GPIO_PIN_RESET);

    *gp = data4;
    res = HAL_SPI_Transmit(&hspi1, &g_data_buf[0], sizeof(uint32_t), 2);
    assert_param(res == HAL_OK);
    if (res != HAL_OK) {
        uart_printf("  data4=0x%08X, res = %u\n", data4, res);
    }

    // Release DCn; DO NOT RELEASE CSn; assume it's handled out of scope
    //HAL_GPIO_WritePin(DISP_CSn_GPIO_Port, DISP_CSn_Pin, GPIO_PIN_SET);
    HAL_GPIO_WritePin(DISP_DCn_GPIO_Port, DISP_DCn_Pin, GPIO_PIN_SET);
}

static void ssd1322_dataN(const uint8_t *data, uint32_t length)
{
    HAL_StatusTypeDef res;
    // Assert CSn and set D/Cn
    HAL_GPIO_WritePin(DISP_DCn_GPIO_Port, DISP_DCn_Pin, GPIO_PIN_SET);
    HAL_GPIO_WritePin(DISP_CSn_GPIO_Port, DISP_CSn_Pin, GPIO_PIN_RESET);
    if (length > 0) {
        res = HAL_SPI_Transmit(&hspi1, (uint8_t*)data, length, 10);
        assert_param(res == HAL_OK);
        if (res != HAL_OK) {
            uart_printf("  dataN(0x%08X, %u) failed, res=%u\n", data, length, res);
        }
    }
    // Release DCn and CSn
    HAL_GPIO_WritePin(DISP_CSn_GPIO_Port, DISP_CSn_Pin, GPIO_PIN_SET);
    HAL_GPIO_WritePin(DISP_DCn_GPIO_Port, DISP_DCn_Pin, GPIO_PIN_SET);
}


static void ssd1322_cmd0(uint8_t cmd)
{
    ssd1322_cmd(cmd);
    HAL_GPIO_WritePin(DISP_CSn_GPIO_Port, DISP_CSn_Pin, GPIO_PIN_SET);
}

static void ssd1322_cmd1(uint8_t cmd, uint8_t a)
{
    ssd1322_cmd(cmd);
    ssd1322_data(a);
    HAL_GPIO_WritePin(DISP_CSn_GPIO_Port, DISP_CSn_Pin, GPIO_PIN_SET);
}

static void ssd1322_cmd2(uint8_t cmd, uint8_t a, uint8_t b)
{
    ssd1322_cmd(cmd);
    ssd1322_data2(a, b);
    HAL_GPIO_WritePin(DISP_CSn_GPIO_Port, DISP_CSn_Pin, GPIO_PIN_SET);
}

static void set_grayscale_table(uint8_t *data, uint32_t length)
{
    if (data == NULL || length != 15) {
        return;
    }

    // Set the table periods GS1..GS15
    ssd1322_cmd(SET_GRAYSCALE_TABLE);
    ssd1322_dataN(data, length);
    ssd1322_cmd0(ENABLE_GRAYSCALE_TABLE);
}


//@} End of Implemented private methods
